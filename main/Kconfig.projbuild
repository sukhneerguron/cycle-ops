## main/Kconfig.projbuild
```kconfig
menu "Cycle-Ops Hardware Configuration"

config I2C_SDA
    int "I2C SDA Pin"
    default 7

config I2C_SCL
    int "I2C SCL Pin"
    default 6

config SPI_MOSI
    int "SPI MOSI Pin"
    default 13

config SPI_SCLK
    int "SPI SCLK Pin"
    default 12

config DISPLAY_CS
    int "Display CS Pin"
    default 11

config DISPLAY_DC
    int "Display DC Pin"
    default 10

config DISPLAY_RST
    int "Display Reset Pin"
    default 9

config DISPLAY_BL
    int "Display Backlight Pin"
    default 8

config DISPLAY_WIDTH
    int "Display Width"
    default 240

config DISPLAY_HEIGHT
    int "Display Height"
    default 320

config TOUCH_INT
    int "Touch Interrupt Pin"
    default 5

config TOUCH_RST
    int "Touch Reset Pin"
    default 4

endmenu
```

## sdkconfig.defaults.esp32s3
```kconfig
# --- I2C Configuration ---
CONFIG_I2C_SDA=7
CONFIG_I2C_SCL=6

# --- SPI Configuration ---
CONFIG_SPI_MOSI=13
CONFIG_SPI_SCLK=12

# --- Display Configuration ---
CONFIG_DISPLAY_CS=11
CONFIG_DISPLAY_DC=10
CONFIG_DISPLAY_RST=9
CONFIG_DISPLAY_BL=8
CONFIG_DISPLAY_WIDTH=240
CONFIG_DISPLAY_HEIGHT=320
```
